#include <ESP8266WiFi.h>
#include <ArduinoJson.h>
#include <Wire.h>
#include <Adafruit_GFX.h>
#include <Adafruit_SSD1306.h>
#define SCREEN_WIDTH 128 // OLED display width, in pixels
#define SCREEN_HEIGHT 64 // OLED display height, in pixels
// Declaration for an SSD1306 display connected to I2C (SDA, SCL pins)
#define OLED_RESET     -1 // Reset pin # (or -1 if sharing Arduino reset pin)
Adafruit_SSD1306 display(SCREEN_WIDTH, SCREEN_HEIGHT, &Wire, OLED_RESET);
//----------------------------------------------------
//USER Setup
// WiFi settings
const char* ssid     = "WIFI SSID";//Network ID: A 2.4ghz WIFI network is prefered as a 5ghz connection could prevent connection.
const char* password = "SSID PASSWORD";//Network password.

//Ticker Settings
int tickerRefesh = 5; //Enter nuber of seconds for price update. (300 = 5 minutes, 86400 = 1 day. Max 25 days at 2,160,000 seconds (not recommended)/)
bool USD = false; //true for USD false for GBP
float rate = 0.81;  // Current GBP price per dollar
//----------------------------------------------------
// API server
const char* host = "api.coindesk.com";
//BTC Image
const unsigned char bitcoinLogo [] PROGMEM =
{
  0x00, 0x00, 0x00, 0x00, 0x00, 0x00, 0x00, 0x00, 0x00, 0x00, 0x00, 0x00, 0x00, 0x00, 0x00, 0x00, 
  0x00, 0x00, 0x00, 0x00, 0x00, 0x00, 0x00, 0x00, 0x00, 0x00, 0x00, 0x00, 0x00, 0x00, 0x00, 0x00, 
  0x00, 0x00, 0x00, 0x00, 0x00, 0x00, 0x00, 0x00, 0x00, 0x00, 0x00, 0x00, 0x00, 0x00, 0x00, 0x00, 
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  0x00, 0x00, 0x00, 0x00, 0x00, 0x00, 0x00, 0x00, 0x00, 0x00, 0x00, 0x00, 0x00, 0x00, 0x00, 0x00
};
//Required Ticker Variables
float oldTickerPrice= 29000.00;
float tickerPrice = 0.00;
boolean updown = false;
String previousAnswer;

void setup() {
  Serial.begin(115200);
  delay(10);
  if(!display.begin(SSD1306_SWITCHCAPVCC, 0x3C)) { 
    Serial.println(F("SSD1306 allocation failed"));
    for(;;);
  }
  display.clearDisplay();
  display.setTextColor(WHITE);
  display.drawBitmap(0, 0, bitcoinLogo, 128, 64, WHITE);
  display.display();
  delay(2000);
  display.clearDisplay();
  display.setTextSize(1);
  display.setTextColor(WHITE);
  display.println("Connecting to API...");
  display.display();
  WiFi.begin(ssid, password);
        Serial.print("Connecting to WIFI:");
        Serial.print(ssid);
        Serial.println(" ...");
        while (WiFi.status() != WL_CONNECTED)
        {
          delay(500);
          Serial.print(".");
        }
        Serial.println();
  display.clearDisplay();
  display.println("Connected via: ");
  display.print(ssid);
  display.display();
  delay(1000);
  display.clearDisplay();
  display.display();
}
 
void loop() {
 
  Serial.print("connecting to ");
  Serial.println(host);

  WiFiClient client;
  const int httpPort = 80;
  if (!client.connect(host, httpPort)) {
    Serial.println("connection failed");
    return;
  }

  String url = "/v1/bpi/currentprice.json";
  
  Serial.print("Requesting URL: ");
  Serial.println(url);

  client.print(String("GET ") + url + " HTTP/1.1\r\n" +
               "Host: " + host + "\r\n" + 
               "Connection: close\r\n\r\n");
  delay(100);

  //Get API details, if no answer use previous.
  String answer;
  while(client.available()){
    String line = client.readStringUntil('\r');
    answer += line;
    previousAnswer = answer;
  }
  if(!client.available()){
    answer=previousAnswer;
  }

  client.stop();
  Serial.println();
  Serial.println("closing connection");

  // Process answer
  Serial.println();
  Serial.println("Answer: ");
  Serial.println(answer);

  // Convert to JSON
  String jsonAnswer;
  int jsonIndex;

  for (int i = 0; i < answer.length(); i++) {
    if (answer[i] == '{') {
      jsonIndex = i;
      break;
    }
  }
  //----------------------------------------
  // Get JSON data
  jsonAnswer = answer.substring(jsonIndex);
  Serial.println();
  Serial.println("JSON answer: ");
  Serial.println(jsonAnswer);
  jsonAnswer.trim();
  
  //USD or GBP
  //----------------------------------------
  String currentPrice;
  if(USD){     
      //USD
      int rateIndex = jsonAnswer.indexOf("rate_float");
      String priceString = jsonAnswer.substring(rateIndex + 12, rateIndex + 20); //dollars with decimal point
      priceString.trim();
      float price = priceString.toFloat();

      String tickPrice;
      tickPrice = priceString;
      tickPrice.replace(",","");
      tickPrice.trim();
      tickerPrice = tickPrice.toFloat();
      currentPrice = priceString;
  }
  else{
      //----------------------------------------
      // GBP
      int rateIndex = jsonAnswer.indexOf("rate_float");
      String priceString = jsonAnswer.substring(rateIndex + 12, rateIndex + 20); 
      priceString.trim();
      float price = (priceString.toFloat())*rate ;

      String tickPrice;
      tickPrice = priceString;
      tickPrice.replace(",","");
      tickPrice.trim();
      tickerPrice = (tickPrice.toFloat())*rate;
      currentPrice = price;
  }
                                           
  display.clearDisplay();
  display.setCursor(0, 0);
  display.setTextSize(1);
  display.setTextColor(WHITE);
  
  //Sets the correct currencie value.
  if(USD){
    display.print("\nBTC \nPrice\nUSD\n"+currentPrice);
  }
  else{
    display.print("\nBTC \nPrice\nGBP\n"+currentPrice);
  }
  
  display.drawBitmap(32, 0, bitcoinLogo, 128, 64, WHITE);
  display.display();
  
  //Ticker Arrow Based On Most Recent Data
  if (oldTickerPrice > tickerPrice)
  {
    //Price goes down.
    Serial.println("Moving Down");
    Serial.println(oldTickerPrice);
    display.drawLine(25, 45, 45, 45, WHITE);
    display.drawLine(45, 45, 35, 55, WHITE);
    display.drawLine(35, 55, 25, 45, WHITE);
    oldTickerPrice = tickerPrice;
    updown = false;
  }
  else if (oldTickerPrice == tickerPrice){
    //Retains ticker arrow state.
    Serial.println("No Change");
    Serial.println(oldTickerPrice);
    if(updown){
      display.drawLine(25, 55, 35, 45, WHITE);//up arrow
      display.drawLine(35, 45, 45, 55, WHITE);
      display.drawLine(45, 55, 25, 55, WHITE);
    }
    else{
      //Price goes up.
      display.drawLine(25, 45, 45, 45, WHITE);//down arrow
      display.drawLine(45, 45, 35, 55, WHITE);
      display.drawLine(35, 55, 25, 45, WHITE);
    }
  }
  else{
    //Price goes up.
    Serial.println("Moving Up");
    Serial.println(tickerPrice);
    oldTickerPrice = tickerPrice;
    updown = true;
    display.drawLine(25, 55, 35, 45, WHITE);//up arrow
    display.drawLine(35, 45, 45, 55, WHITE);
    display.drawLine(45, 55, 25, 55, WHITE);
  }
  display.display();
  //sets the refresh time before another API call in milliseconds.
  delay(tickerRefesh*1000);
}
